## kernel.its
```
/dts-v1/;

/ {
        description = "Boot Linux kernel";
        #address-cells = <1>;

        images {
                kernel-1 {
                        description = "Linux kernel 5.10.23-olimex";
                        data = /incbin/("./arch/arm/boot/zImage");
                        type = "kernel";
                        arch = "arm";
                        os = "linux";
                        compression = "none";
                        load = <0x40080000>;
                        entry = <0x40080000>;
                        hash-1 {
                                algo = "crc32";
                        };
                        hash-2 {
                                algo = "sha1";
                        };
                };

                fdt-6 {
                    data = /incbin/("./arch/arm/boot/dts/sun7i-a20-olinuxino-micro-emmc.dtb");
                    type = "flat_dt";
                    arch = "arm";
                    compression = "none";
                    load = <0x4FA00000>;
                    hash-1 {
                            algo = "crc32";
                    };
                    hash-2 {
                            algo = "sha1";
                    };
                };

                overlay-1 {
                    data = /incbin/("./olinuxino-overlays/sun7i-a20/sun7i-a20-spi0.dtbo");
                    type = "flat_dt";
                    arch = "arm";
                    compression = "none";
                    load = <0x4FA10000>;
                    hash-1 {
                            algo = "crc32";
                    };
                    hash-2 {
                            algo = "sha1";
                    };
                };

                overlay-2 {
                    data = /incbin/("./olinuxino-overlays/sun7i-a20/spi0-spiflash.dtbo");
                    type = "flat_dt";
                    arch = "arm";
                    compression = "none";
                    load = <0x4FA20000>;
                    hash-1 {
                            algo = "crc32";
                    };
                    hash-2 {
                            algo = "sha1";
                    };
                };
        };

        configurations {
                default = "config-9789";

                config-9789 {
                        description = "Boot Linux kernel 5.10.23-olimex with T2-OLinuXino-MICRO-e8Gs16M-IND";
                        kernel = "kernel-1";
                        fdt = "fdt-6", "overlay-1", "overlay-2";
                        compatible = "olimex,t2-olinuxino-micro-e8gs16m-ind";
                };
        };
};
```
